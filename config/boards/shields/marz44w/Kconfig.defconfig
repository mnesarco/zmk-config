## config/boards/shields/marz44w/Kconfig.defconfig
```kconfig
# Copyright (c) 2025 Frank David Martínez Muñoz <mnesarco>
# SPDX-License-Identifier: MIT

if SHIELD_MARZ44W_DONGLE

config ZMK_KEYBOARD_NAME
	default "marz44w Dongle"

config ZMK_SPLIT_BLE_ROLE_CENTRAL
	default y

config ZMK_USB
	default y

endif

if SHIELD_MARZ44W_LEFT || SHIELD_MARZ44W_RIGHT || SHIELD_MARZ44W_DONGLE

config ZMK_SPLIT
	default y

config ZMK_BLE
	default y

endif
```

## config/boards/shields/marz44w/Kconfig.shield
```kconfig
# Copyright (c) 2025 Frank David Martínez Muñoz <mnesarco>
# SPDX-License-Identifier: MIT

config SHIELD_MARZ44W_LEFT
	def_bool $(shields_list_contains,marz44w_left)

config SHIELD_MARZ44W_RIGHT
	def_bool $(shields_list_contains,marz44w_right)

config SHIELD_MARZ44W_DONGLE
	def_bool $(shields_list_contains,marz44w_dongle)
```
