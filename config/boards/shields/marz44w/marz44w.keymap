/*
 * Copyright (c) 2025 Frank David Martínez Muñoz <mnesarco>
 * SPDX-License-Identifier: MIT
 */

#include <behaviors.dtsi>
#include <dt-bindings/zmk/keys.h>
#include <dt-bindings/zmk/bt.h>
#include <dt-bindings/zmk/ext_power.h>
#include <dt-bindings/zmk/outputs.h>
#include <behaviors/num_word.dtsi>

#define LA_MINUS SLASH
#define LA_UND LS(LA_MINUS)

&caps_word {
    continue-list = <LA_UND LA_MINUS>;
};

&num_word {
  continue-list = <BSPC DEL DOT COMMA RBKT LS(RBRC) LS(N7) LS(N0) SLASH>;
};

/*
/ {
    behaviors {
        mt: mod_tap {
            compatible = "zmk,behavior-hold-tap";
            flavor = "balanced";
            tapping-term-ms = <250>;
            quick-tap-ms = <150>;
            hold-trigger-on-release;
        };
    };
};
*/

#include "marz44w_keymap.dtsi"